## layers/meta-balena-raspberrypi/conf/machine/raspberrypicm4-ioboard.conf
```bitbake
#@TYPE: Machine
#@NAME: RaspberrypiCM4-IOBoard
#@DESCRIPTION: Machine configuration for Raspberrypi Compute Module 4 IO Board

MACHINEOVERRIDES = "raspberrypi4-64:${MACHINE}"
include conf/machine/raspberrypi4-64.conf

MACHINE_FEATURES += "alsa"

IMAGE_INSTALL:append = " \
	alsa-utils \
	alsa-plugins \
	alsa-tools \
	seeed-voicecard \
"

RPI_EXTRA_CONFIG += '\ndtparam=i2c_arm=on\ndtparam=i2s=on\ndtparam=spi=on\n# Enable audio (loads snd_bcm2835)\ndtparam=audio=on\ndtoverlay=i2s-mmap\ndtoverlay=seeed-2mic-voicecard'

KERNEL_DEVICETREE:append = " \
    overlays/seeed-2mic-voicecard.dtbo \
    overlays/seeed-4mic-voicecard.dtbo \
    overlays/seeed-8mic-voicecard.dtbo \
"

OS_DEVELOPMENT = "1"

# because we override the raspberrypi4-64 machine which in turn is an override of raspberrypi4, we need to do the following gimmick:
# courtesy of https://github.com/balena-os/balena-jetson/pull/112/commits/9d21df6899e595b4aeab4cc9a939ae6c564c669a
MACHINEOVERRIDES := "${@'${MACHINEOVERRIDES}'.replace(':${MACHINE}',':raspberrypi4-64:${MACHINE}')}"
```
